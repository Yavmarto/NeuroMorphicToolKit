/*
 * Classical Conditioning (Pavlovian Learning) — Phase 3 Hardware Demo #2
 *
 * Tone (CS) + Light (US) → STDP associates them over repeated pairings.
 * 4-phase protocol: Baseline → Conditioning → Test → Extinction.
 *
 * Hardware:
 *   Pin A0  — Tone sensor (mic / button simulating CS)
 *   Pin A1  — Light sensor (LDR / button simulating US)
 *   Pin 9   — Response servo (salivation analog)
 *   Pin 13  — Built-in LED (phase indicator)
 *   Serial  — 115200 baud for telemetry
 *
 * SNN parameters are imported from snn_network.h (generated by NeuroCNL).
 */

#include <Servo.h>
#include "snn_network.h"

/* ── Pin definitions ──────────────────────────────────────────── */
#define TONE_PIN       A0
#define LIGHT_PIN      A1
#define SERVO_PIN      9
#define LED_PIN        13

/* ── SNN indices (from generated header: sensory=0, motor=1) ── */
#define SENSORY_INDEX  0
#define MOTOR_INDEX    (SENSORY_NEURON_N_NEURONS)

/* ── STDP / learning parameters (from CNL spec) ──────────────── */
#define LEARNING_RATE  0.005f
#define WEIGHT_MIN     0.1f
#define WEIGHT_MAX     2.0f
#define INITIAL_WEIGHT 0.3f

/* ── Stimulus detection thresholds ────────────────────────────── */
#define TONE_THRESHOLD  0.3f
#define LIGHT_THRESHOLD 0.3f
#define US_STRENGTH     1.5f    /* strong innate visual→motor drive */

/* ── Timing ───────────────────────────────────────────────────── */
#define SNN_DT           0.002f
static unsigned long last_step_us = 0;
#define STEP_INTERVAL_US ((unsigned long)(SNN_DT * 1e6f))

/* ── Phase management ─────────────────────────────────────────── */
enum Phase { BASELINE = 1, CONDITIONING, TEST, EXTINCTION };
static Phase current_phase   = BASELINE;
static int   trial_count     = 0;
static int   trials_in_phase = 0;

#define BASELINE_TRIALS      5
#define CONDITIONING_TRIALS  25
#define TEST_TRIALS          5
#define EXTINCTION_TRIALS    15

/* ── State ────────────────────────────────────────────────────── */
static float cs_weight = INITIAL_WEIGHT;
Servo response_servo;

/* ── Helpers ──────────────────────────────────────────────────── */

static float read_normalised(int pin) {
    return analogRead(pin) / 1023.0f;
}

static int spike_to_angle(int motor_start, int motor_count) {
    int count = 0;
    for (int i = motor_start; i < motor_start + motor_count; i++) {
        count += spikes[i];
    }
    return (count > 0) ? 90 : 0;   /* 90° = full response, 0° = rest */
}

static void advance_phase(void) {
    trials_in_phase++;

    switch (current_phase) {
        case BASELINE:
            if (trials_in_phase >= BASELINE_TRIALS) {
                current_phase = CONDITIONING;
                trials_in_phase = 0;
                Serial.println("# >>> Entering CONDITIONING phase");
            }
            break;
        case CONDITIONING:
            if (trials_in_phase >= CONDITIONING_TRIALS) {
                current_phase = TEST;
                trials_in_phase = 0;
                Serial.println("# >>> Entering TEST phase");
            }
            break;
        case TEST:
            if (trials_in_phase >= TEST_TRIALS) {
                current_phase = EXTINCTION;
                trials_in_phase = 0;
                Serial.println("# >>> Entering EXTINCTION phase");
            }
            break;
        case EXTINCTION:
            if (trials_in_phase >= EXTINCTION_TRIALS) {
                Serial.println("# >>> Protocol complete — restarting");
                current_phase = BASELINE;
                trials_in_phase = 0;
                cs_weight = INITIAL_WEIGHT;
            }
            break;
    }
}

/* ── Arduino setup ────────────────────────────────────────────── */
void setup() {
    Serial.begin(115200);
    while (!Serial) { /* wait for USB serial on Teensy */ }

    pinMode(LED_PIN, OUTPUT);
    response_servo.attach(SERVO_PIN);
    response_servo.write(0);
    analogReadResolution(10);

    /* Zero SNN state */
    for (int i = 0; i < TOTAL_NEURONS; i++) {
        voltage[i]    = 0.0f;
        refractory[i] = 0.0f;
        spikes[i]     = 0;
    }

    Serial.println("# Classical Conditioning Demo — ready");
    Serial.println("# phase,trial,tone,light,cs_weight,servo_angle");
}

/* ── Arduino main loop ────────────────────────────────────────── */
void loop() {
    unsigned long now = micros();
    if (now - last_step_us < STEP_INTERVAL_US) return;
    last_step_us = now;

    /* Phase indicator: blink LED pattern matches current phase number */
    digitalWrite(LED_PIN, (millis() / (500 / current_phase)) & 1);

    /* 1. Read sensors */
    float tone_val  = read_normalised(TONE_PIN);
    float light_val = read_normalised(LIGHT_PIN);

    int tone_active  = (tone_val  > TONE_THRESHOLD)  ? 1 : 0;
    int light_active = (light_val > LIGHT_THRESHOLD) ? 1 : 0;

    /* 2. Build SNN input array */
    float input[TOTAL_NEURONS];
    for (int i = 0; i < TOTAL_NEURONS; i++) input[i] = 0.0f;

    /* CS pathway: tone drives sensory neurons, weighted by learned connection */
    if (tone_active) {
        for (int i = 0; i < SENSORY_NEURON_N_NEURONS; i++) {
            input[SENSORY_INDEX + i] = tone_val * cs_weight;
        }
    }

    /* US pathway: light provides strong direct drive to motor neurons */
    if (light_active) {
        for (int i = 0; i < MOTOR_NEURON_N_NEURONS; i++) {
            input[MOTOR_INDEX + i] = light_val * US_STRENGTH;
        }
    }

    /* 3. Run one LIF network step */
    lif_step(SNN_DT, input);

    /* 4. Decode motor spikes → servo angle */
    int angle = spike_to_angle(MOTOR_INDEX, MOTOR_NEURON_N_NEURONS);
    response_servo.write(angle);

    /* 5. STDP weight update */
    int sensory_fired = 0;
    int motor_fired   = 0;
    for (int i = SENSORY_INDEX; i < SENSORY_INDEX + SENSORY_NEURON_N_NEURONS; i++) {
        sensory_fired += spikes[i];
    }
    for (int i = MOTOR_INDEX; i < MOTOR_INDEX + MOTOR_NEURON_N_NEURONS; i++) {
        motor_fired += spikes[i];
    }

    if (sensory_fired > 0 && motor_fired > 0) {
        /* Pre (sensory/CS) and post (motor) co-active → strengthen */
        cs_weight += LEARNING_RATE;
        if (cs_weight > WEIGHT_MAX) cs_weight = WEIGHT_MAX;
    } else if (sensory_fired == 0 && motor_fired > 0) {
        /* Post without pre → weaken (anti-causal) */
        cs_weight -= LEARNING_RATE * 0.5f;
        if (cs_weight < WEIGHT_MIN) cs_weight = WEIGHT_MIN;
    }

    /* 6. Trial counting — advance phase on each stimulus presentation */
    if (tone_active || light_active) {
        trial_count++;
        advance_phase();
    }

    /* 7. Serial telemetry */
    Serial.print(current_phase);   Serial.print(',');
    Serial.print(trial_count);     Serial.print(',');
    Serial.print(tone_val, 3);     Serial.print(',');
    Serial.print(light_val, 3);    Serial.print(',');
    Serial.print(cs_weight, 4);    Serial.print(',');
    Serial.println(angle);
}
