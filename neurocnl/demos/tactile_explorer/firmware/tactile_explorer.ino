/*
 * Tactile Explorer Robot — Phase 3 Hardware Demo #6
 *
 * Whisker-based obstacle avoidance using a spiking neural network
 * with contralateral motor mapping (left whisker → right motor).
 *
 * Hardware:
 *   Pin A0  — Left whisker  (FSR or microswitch + voltage divider)
 *   Pin A1  — Right whisker  (FSR or microswitch + voltage divider)
 *   Pin 9   — Left motor PWM  (servo or DC motor via H-bridge)
 *   Pin 10  — Right motor PWM (servo or DC motor via H-bridge)
 *   Serial  — 115200 baud for telemetry
 *
 * SNN parameters are imported from snn_network.h (generated by NeuroCNL).
 */

#include "snn_network.h"

/* ── Pin definitions ──────────────────────────────────────────── */
#define LEFT_WHISKER_PIN   A0
#define RIGHT_WHISKER_PIN  A1
#define LEFT_MOTOR_PIN     9
#define RIGHT_MOTOR_PIN    10

/* ── Delta-encoding state ─────────────────────────────────────── */
static float left_ref  = 0.0f;
static float right_ref = 0.0f;
#define DELTA_THRESHOLD 0.1f   /* minimum change to trigger a spike */

/* ── Motor parameters ─────────────────────────────────────────── */
#define BASE_SPEED   150       /* default forward PWM (0–255)      */
#define SPIKE_GAIN   20        /* extra PWM per motor spike         */
#define REVERSE_MS   300       /* duration of reverse manoeuvre     */

/* ── Timing ───────────────────────────────────────────────────── */
#define SNN_DT       0.002f    /* 2 ms network timestep             */
static unsigned long last_step_us = 0;
#define STEP_INTERVAL_US ((unsigned long)(SNN_DT * 1e6f))

/* ── Helpers ──────────────────────────────────────────────────── */

/* Read a whisker FSR and normalise to 0.0 – 1.0. */
static float read_whisker(int pin) {
    return analogRead(pin) / 1023.0f;
}

/* Delta-encode one channel: returns 1.0 if spike, 0.0 otherwise. */
static float delta_encode(float value, float *ref) {
    float diff = value - *ref;
    if (diff < 0.0f) diff = -diff;
    if (diff >= DELTA_THRESHOLD) {
        *ref = value;
        return 1.0f;
    }
    return 0.0f;
}

/* Count spikes in a neuron range [start, end). */
static int count_spikes(int start, int end) {
    int count = 0;
    for (int i = start; i < end; i++) {
        count += spikes[i];
    }
    return count;
}

/* ── Arduino setup ────────────────────────────────────────────── */
void setup() {
    Serial.begin(115200);
    while (!Serial) { /* wait for USB serial on Teensy */ }

    pinMode(LEFT_MOTOR_PIN,  OUTPUT);
    pinMode(RIGHT_MOTOR_PIN, OUTPUT);

    analogReadResolution(10);   /* 10-bit ADC (0–1023) */

    /* Zero SNN state */
    for (int i = 0; i < TOTAL_NEURONS; i++) {
        voltage[i]    = 0.0f;
        refractory[i] = 0.0f;
        spikes[i]     = 0;
    }

    Serial.println("# Tactile Explorer Robot — ready");
    Serial.println("# left_whisker,right_whisker,left_motor,right_motor");
}

/* ── Arduino main loop ────────────────────────────────────────── */
void loop() {
    unsigned long now = micros();
    if (now - last_step_us < STEP_INTERVAL_US) return;
    last_step_us = now;

    /* 1. Read both whisker sensors */
    float left_val  = read_whisker(LEFT_WHISKER_PIN);
    float right_val = read_whisker(RIGHT_WHISKER_PIN);

    /* 2. Delta-encode on-device: spike when change exceeds threshold */
    float left_spike  = delta_encode(left_val,  &left_ref);
    float right_spike = delta_encode(right_val, &right_ref);

    /* 3. Build SNN input array.
     *    Left whisker  → first half of sensory neurons
     *    Right whisker → second half of sensory neurons
     */
    float input[TOTAL_NEURONS];
    for (int i = 0; i < TOTAL_NEURONS; i++) input[i] = 0.0f;

    int half_sensory = SENSORY_N_NEURONS / 2;
    for (int i = 0; i < half_sensory; i++) {
        input[SENSORY_INDEX + i] = left_spike * W_SENSORY_TO_MOTOR;
    }
    for (int i = half_sensory; i < SENSORY_N_NEURONS; i++) {
        input[SENSORY_INDEX + i] = right_spike * W_SENSORY_TO_MOTOR;
    }

    /* 4. Run one LIF network step */
    lif_step(SNN_DT, input);

    /* 5. Decode motor spikes — CONTRALATERAL mapping:
     *    Left motor speed  ∝ right whisker motor spikes
     *    Right motor speed ∝ left whisker motor spikes
     */
    int motor_start = MOTOR_INDEX;
    int motor_half  = MOTOR_N_NEURONS / 2;

    int left_motor_spikes  = count_spikes(motor_start, motor_start + motor_half);
    int right_motor_spikes = count_spikes(motor_start + motor_half,
                                          motor_start + MOTOR_N_NEURONS);

    /* Contralateral wiring:
     *   right_motor_spikes are driven by left whisker sensory input
     *   left_motor_spikes  are driven by right whisker sensory input
     */
    int left_speed  = BASE_SPEED + left_motor_spikes  * SPIKE_GAIN;
    int right_speed = BASE_SPEED + right_motor_spikes * SPIKE_GAIN;

    /* Clamp to valid PWM range */
    if (left_speed  > 255) left_speed  = 255;
    if (right_speed > 255) right_speed = 255;

    /* Both whiskers active → reverse */
    if (left_spike > 0.5f && right_spike > 0.5f) {
        analogWrite(LEFT_MOTOR_PIN,  0);
        analogWrite(RIGHT_MOTOR_PIN, 0);
        delay(REVERSE_MS);
        /* Reverse briefly handled by H-bridge direction pins (not shown) */
    }

    /* 6. Drive motors with PWM */
    analogWrite(LEFT_MOTOR_PIN,  left_speed);
    analogWrite(RIGHT_MOTOR_PIN, right_speed);

    /* 7. Serial telemetry */
    Serial.print(left_val,  3);  Serial.print(',');
    Serial.print(right_val, 3);  Serial.print(',');
    Serial.print(left_speed);    Serial.print(',');
    Serial.println(right_speed);
}
