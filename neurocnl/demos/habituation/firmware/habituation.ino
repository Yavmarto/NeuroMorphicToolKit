/*
 * Habituation / Sensitization — Phase 3 Hardware Demo #4
 *
 * Non-associative learning on Teensy 4.1: repeated button presses
 * weaken the sensory→motor connection (habituation), and a long
 * press restores it (sensitization).  Modelled on Kandel's Aplysia.
 *
 * Hardware (~€5):
 *   Pin 2   — Push button input (stimulus), with 10kΩ pull-down
 *   Pin 9   — Servo signal (response strength)  OR
 *   Pin 13  — Built-in LED (PWM brightness as simpler alternative)
 *   Serial  — 115200 baud for telemetry
 *
 * SNN parameters imported from snn_network.h (generated by NeuroCNL).
 */

#include "snn_network.h"

/* ── Pin definitions ──────────────────────────────────────────── */
#define BUTTON_PIN    2
#define LED_PIN       13
#define SERVO_PIN     9

/* ── Habituation parameters (from CNL spec) ───────────────────── */
#define INITIAL_WEIGHT  0.8f
#define LEARNING_RATE   0.02f
#define WEIGHT_MIN      0.1f
#define WEIGHT_MAX      1.5f

/* ── Sensitization parameters ─────────────────────────────────── */
#define LONG_PRESS_MS     1000     /* hold >1s for sensitization       */
#define SENSITIZE_BOOST   0.4f    /* weight restoration amount         */

/* ── Timing ───────────────────────────────────────────────────── */
#define SNN_DT            0.002f  /* 2 ms network timestep             */
#define DEBOUNCE_MS       50      /* button debounce window            */
#define RESPONSE_WINDOW   100     /* ms to count motor spikes          */

static unsigned long last_step_us = 0;
#define STEP_INTERVAL_US ((unsigned long)(SNN_DT * 1e6f))

/* ── State ────────────────────────────────────────────────────── */
static float    hab_weight     = INITIAL_WEIGHT;
static int      trial_number   = 0;
static bool     button_prev    = false;
static unsigned long press_start = 0;

/* ── Helpers ──────────────────────────────────────────────────── */

static int count_spikes(int start, int end) {
    int count = 0;
    for (int i = start; i < end; i++) {
        count += spikes[i];
    }
    return count;
}

/* Map weight to LED brightness (0–255) or servo angle (0–180). */
static int weight_to_brightness(float w) {
    int val = (int)(w / WEIGHT_MAX * 255.0f);
    if (val < 0)   val = 0;
    if (val > 255) val = 255;
    return val;
}

/* ── Arduino setup ────────────────────────────────────────────── */
void setup() {
    Serial.begin(115200);
    while (!Serial) { /* wait for USB serial on Teensy */ }

    pinMode(BUTTON_PIN, INPUT);
    pinMode(LED_PIN,    OUTPUT);
    pinMode(SERVO_PIN,  OUTPUT);

    /* Zero SNN state */
    for (int i = 0; i < TOTAL_NEURONS; i++) {
        voltage[i]    = 0.0f;
        refractory[i] = 0.0f;
        spikes[i]     = 0;
    }

    Serial.println("# Habituation Demo — ready");
    Serial.println("# trial,weight,response,event");
}

/* ── Arduino main loop ────────────────────────────────────────── */
void loop() {
    unsigned long now_us = micros();
    if (now_us - last_step_us < STEP_INTERVAL_US) return;
    last_step_us = now_us;

    unsigned long now_ms = millis();

    /* 1. Read button with debounce */
    bool button_now = digitalRead(BUTTON_PIN) == HIGH;
    bool rising_edge  = button_now && !button_prev;
    bool falling_edge = !button_now && button_prev;

    if (rising_edge) {
        press_start = now_ms;
    }

    bool stimulus_detected = false;
    bool long_press = false;

    if (falling_edge) {
        unsigned long held = now_ms - press_start;
        if (held >= DEBOUNCE_MS) {
            stimulus_detected = true;
            if (held >= LONG_PRESS_MS) {
                long_press = true;
            }
        }
    }
    button_prev = button_now;

    /* 2. Feed stimulus to sensory neurons */
    float input[TOTAL_NEURONS];
    for (int i = 0; i < TOTAL_NEURONS; i++) input[i] = 0.0f;

    if (stimulus_detected) {
        for (int i = SENSORY_INDEX; i < SENSORY_INDEX + SENSORY_N_NEURONS; i++) {
            input[i] = hab_weight * 2.0f;
        }
    }

    /* 3. Run one LIF network step */
    lif_step(SNN_DT, input);

    /* 4. Count motor spikes → response strength */
    int motor_spk = count_spikes(MOTOR_INDEX, MOTOR_INDEX + MOTOR_N_NEURONS);
    bool motor_responded = (motor_spk > 0);

    /* 5. Habituation: decay weight after each stimulus–response cycle */
    if (stimulus_detected) {
        trial_number++;

        if (long_press) {
            /* Sensitization: restore weight partially */
            hab_weight += SENSITIZE_BOOST;
            if (hab_weight > WEIGHT_MAX) hab_weight = WEIGHT_MAX;

            Serial.print(trial_number);
            Serial.print(",");
            Serial.print(hab_weight, 4);
            Serial.print(",");
            Serial.print(motor_spk);
            Serial.println(",sensitization");
        } else {
            /* Habituation: weaken connection */
            if (motor_responded) {
                hab_weight -= LEARNING_RATE;
                if (hab_weight < WEIGHT_MIN) hab_weight = WEIGHT_MIN;
            }

            Serial.print(trial_number);
            Serial.print(",");
            Serial.print(hab_weight, 4);
            Serial.print(",");
            Serial.print(motor_spk);
            Serial.println(",stimulus");
        }

        /* Update LED/servo to reflect current response strength */
        int brightness = weight_to_brightness(hab_weight);
        analogWrite(LED_PIN, brightness);
    }
}
